## config/west.yml
```yaml
manifest:
  remotes:
    - name: rej696
      url-base: https://github.com/rej696
  projects:
    - name: zmk
      remote: rej696
      revision: rej696/zen-v1+v2
      import: app/west.yml
  self:
    path: config
```
